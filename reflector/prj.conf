## CMakeLists.txt
```
cmake_minimum_required(VERSION 3.20.0)

find_package(Zephyr REQUIRED HINTS $ENV{ZEPHYR_BASE})
project(cs_reflector)

target_sources(app PRIVATE src/main.c)
```

## prj.conf
```kconfig
# ── Base Bluetooth ──
CONFIG_BT=y
CONFIG_BT_PERIPHERAL=y
CONFIG_BT_DEVICE_NAME="CS Reflector"
# A single initiator served at a time
CONFIG_BT_MAX_CONN=1

# ── Security (answers the initiator's BT_SECURITY_L2) ──
CONFIG_BT_SMP=y
# No bonding: without CONFIG_BT_SETTINGS the keys do not survive a reboot, and
# stale RAM bonds break re-securing (err 2 PIN_OR_KEY_MISSING) and saturate the
# key pool (-ENOMEM). CS security only requires an encrypted link: per-session
# pairing, no storage.
CONFIG_BT_BONDABLE=n

# ── Channel Sounding ──
CONFIG_BT_CHANNEL_SOUNDING=y
# Aligned on the initiator: CS event reservation >= the negotiated
# max_subevent_len. MUST FOLLOW THE INITIATOR'S PROFILE FAMILY (cs_config.h):
#   DRONE_FAST_OUTDOOR (subevent 4500) -> 5000
#   DRONE_INDOOR / BOAT_DOCKING (subevent 8000, precision overlay) -> 8500
# Reflash the reflectors on every family change.
CONFIG_BT_CTLR_SDC_CS_EVENT_LEN_DEFAULT=8500
# Lets CS and ACL use different PHYs (validated sample)
CONFIG_BT_TRANSMIT_POWER_CONTROL=y
# The initiator rejects parameter-update requests (le_param_req -> false):
# we do not emit any (avoids noise, validated sample)
CONFIG_BT_GAP_AUTO_UPDATE_CONN_PARAMS=n

# ── Ranging Service: server (Ranging ReSPonder) ──
CONFIG_BT_RAS=y
CONFIG_BT_RAS_RRSP=y
# Retention: keep 10 procedures (instead of 1) so the initiator in CONTINUOUS
# mode has time to fetch a counter before it is overwritten.
CONFIG_BT_RAS_RRSP_RD_BUFFERS_PER_CONN=10

# ── MTU/ACL aligned on the initiator ──
CONFIG_BT_L2CAP_TX_MTU=247
CONFIG_BT_BUF_ACL_TX_SIZE=251
CONFIG_BT_BUF_ACL_RX_SIZE=251

# ── Misc ──
CONFIG_DK_LIBRARY=y
CONFIG_LOG=y

# ── RTT: enlarged buffer so the boot logs are not lost before the JLink
#    terminal attaches (1 KB by default, skip mode) ──
CONFIG_USE_SEGGER_RTT=y
CONFIG_LOG_BACKEND_RTT=y
CONFIG_SEGGER_RTT_BUFFER_SIZE_UP=4096
```

## src/main.c
```c
/*
 * Copyright (c) 2024 Nordic Semiconductor ASA
 * SPDX-License-Identifier: LicenseRef-Nordic-5-Clause
 */

#include <zephyr/kernel.h>
#include <zephyr/bluetooth/bluetooth.h>
#include <zephyr/bluetooth/conn.h>
#include <zephyr/bluetooth/cs.h>
#include <zephyr/bluetooth/uuid.h>
#include <bluetooth/services/ras.h>

#include <dk_buttons_and_leds.h>

#include <zephyr/logging/log.h>
LOG_MODULE_REGISTER(app_main, LOG_LEVEL_INF);

#define CON_STATUS_LED DK_LED1

/* Ranging Service UUID 0x185B — filter used by the initiator */
static const struct bt_data ad[] = {
	BT_DATA_BYTES(BT_DATA_FLAGS, (BT_LE_AD_GENERAL | BT_LE_AD_NO_BREDR)),
	BT_DATA_BYTES(BT_DATA_UUID16_ALL,
		      BT_UUID_16_ENCODE(BT_UUID_RANGING_SERVICE_VAL)),
	BT_DATA(BT_DATA_NAME_COMPLETE,
		CONFIG_BT_DEVICE_NAME, sizeof(CONFIG_BT_DEVICE_NAME) - 1),
};

/* ── Advertising (re)start via workqueue ────────────────────────────────
 * NEVER call bt_le_adv_start() directly in disconnected_cb: the connection
 * object is not freed yet at that instant, and with CONFIG_BT_MAX_CONN=1
 * there is no free slot → -ENOMEM → the reflector never re-advertises
 * again. So we defer to the system workqueue, retrying until the slot is
 * released. */
static void adv_work_handler(struct k_work *work);
static K_WORK_DELAYABLE_DEFINE(adv_work, adv_work_handler);

static void adv_work_handler(struct k_work *work)
{
	int err = bt_le_adv_start(BT_LE_ADV_CONN_FAST_2, ad, ARRAY_SIZE(ad), NULL, 0);

	if (err == -EALREADY) {
		return;
	}
	if (err) {
		LOG_WRN("Adv start failed (err %d), retry in 500 ms", err);
		k_work_schedule(&adv_work, K_MSEC(500));
		return;
	}
	LOG_INF("Advertising...");
}

static void connected_cb(struct bt_conn *conn, uint8_t err)
{
	char addr[BT_ADDR_LE_STR_LEN];

	bt_addr_le_to_str(bt_conn_get_dst(conn), addr, sizeof(addr));
	LOG_INF("Connected to %s (err 0x%02X)", addr, err);

	if (err) {
		/* A failed connection also stops advertising: restart it */
		k_work_schedule(&adv_work, K_MSEC(100));
		return;
	}

	dk_set_led_on(CON_STATUS_LED);

	/* The RAS RRSP instance is allocated AUTOMATICALLY by the service on
	 * connection (CONFIG_BT_RAS_RRSP_AUTO_ALLOC_INSTANCE=y, NCS 3.x default).
	 * An explicit bt_ras_rrsp_alloc() here would return an error (instance
	 * already taken) — this was the cause of the 0x13 disconnections that
	 * aborted the pairing (Security failed err 9 on the initiator side). */

	/* Channel Sounding role: reflector only.
	 * The responses to the CS procedures (mode 0/2) and to CS security are
	 * then handled automatically by the controller. */
	const struct bt_le_cs_set_default_settings_param default_settings = {
		.enable_initiator_role     = false,
		.enable_reflector_role     = true,
		.cs_sync_antenna_selection = BT_LE_CS_ANTENNA_SELECTION_OPT_REPETITIVE,
		.max_tx_power              = BT_HCI_OP_LE_CS_MAX_MAX_TX_POWER,
	};

	int ret = bt_le_cs_set_default_settings(conn, &default_settings);

	if (ret) {
		LOG_ERR("CS default settings failed (err %d)", ret);
		bt_conn_disconnect(conn, BT_HCI_ERR_REMOTE_USER_TERM_CONN);
	}
}

static void disconnected_cb(struct bt_conn *conn, uint8_t reason)
{
	LOG_INF("Disconnected (reason 0x%02X)", reason);
	dk_set_led_off(CON_STATUS_LED);

	/* RAS instance freed automatically (AUTO_ALLOC_INSTANCE) */

	/* Deferred restart: the connection slot is only released after this
	 * callback returns. 100 ms + retry covers all cases. */
	k_work_schedule(&adv_work, K_MSEC(100));
}

static void security_changed_cb(struct bt_conn *conn, bt_security_t level,
				enum bt_security_err err)
{
	if (err) {
		LOG_ERR("Security failed (err %d)", err);
		return;
	}
	LOG_INF("Security level %d", level);
}

BT_CONN_CB_DEFINE(conn_cb) = {
	.connected        = connected_cb,
	.disconnected     = disconnected_cb,
	.security_changed = security_changed_cb,
};

int main(void)
{
	int err;

	LOG_INF("Starting CS reflector");

	dk_leds_init();

	err = bt_enable(NULL);
	if (err) {
		LOG_ERR("Bluetooth init failed (err %d)", err);
		return 0;
	}

	k_work_schedule(&adv_work, K_NO_WAIT);
	return 0;
}
```
