## initiator/build/Kconfig/boards/Kconfig.sysbuild
```kconfig
# Load Sysbuild board Kconfig descriptions.
osource "/home/antoninbo/ncs/v3.3.0/zephyr/boards/nordic/nrf54l15dk/Kconfig.sysbuild"
```

## reflector/build/Kconfig/arch/Kconfig
```kconfig
# Load Zephyr Arch Kconfig descriptions.
osource "/home/antoninbo/ncs/v3.3.0/zephyr/arch/rx/Kconfig"
osource "/home/antoninbo/ncs/v3.3.0/zephyr/arch/x86/Kconfig"
osource "/home/antoninbo/ncs/v3.3.0/zephyr/arch/xtensa/Kconfig"
osource "/home/antoninbo/ncs/v3.3.0/zephyr/arch/sparc/Kconfig"
osource "/home/antoninbo/ncs/v3.3.0/zephyr/arch/riscv/Kconfig"
osource "/home/antoninbo/ncs/v3.3.0/zephyr/arch/posix/Kconfig"
osource "/home/antoninbo/ncs/v3.3.0/zephyr/arch/mips/Kconfig"
osource "/home/antoninbo/ncs/v3.3.0/zephyr/arch/arm64/Kconfig"
osource "/home/antoninbo/ncs/v3.3.0/zephyr/arch/arm/Kconfig"
osource "/home/antoninbo/ncs/v3.3.0/zephyr/arch/arc/Kconfig"
```

## reflector/build/Kconfig/boards/Kconfig.defconfig.tmp
```kconfig
# Load Zephyr board defconfig descriptions.
osource "/home/antoninbo/ncs/v3.3.0/zephyr/boards/nordic/nrf54l15dk/Kconfig.defconfig"
```
